## example/Linux Device Driver Programming 驅動程式設計/TW-samples/chap4/drv_kconfig/Kconfig.diff
```kconfig
*** Kconfig.org	2007-10-13 01:43:44.000000000 +0900
--- Kconfig	2007-11-21 14:41:19.000000000 +0900
***************
*** 4,9 ****
--- 4,14 ----
  
  menu "Character devices"
  
+ config HELLO
+ 	tristate "hello driver"
+ 	---help---
+ 	  This is a sample driver.
+ 
  config VT
  	bool "Virtual terminal" if EMBEDDED
  	depends on !S390
```
